## config/boards/shields/dac_man_4x5/Kconfig.defconfig
```kconfig
if SHIELD_DAC_MAN_4X5_LEFT

config ZMK_KEYBOARD_NAME
    default "Dac-Man-4x5-L"

config ZMK_SPLIT_BLE_ROLE_CENTRAL
    default y

endif

if SHIELD_DAC_MAN_4X5_RIGHT

config ZMK_KEYBOARD_NAME
    default "Dac-Man-4x5-R"

endif

if SHIELD_DAC_MAN_4X5_LEFT || SHIELD_DAC_MAN_4X5_RIGHT

config ZMK_SPLIT
    default y
endif
```

## config/boards/shields/dac_man_4x5/Kconfig.shield
```kconfig
config SHIELD_DAC_MAN_4X5_LEFT
    def_bool $(shields_list_contains,dac_man_4x5_left)

config SHIELD_DAC_MAN_4X5_RIGHT
    def_bool $(shields_list_contains,dac_man_4x5_right)
```

## config/boards/shields/dactyl-manuform/Kconfig.defconfig
```kconfig
if SHIELD_DACTYL_MANUFORM_LEFT

config ZMK_KEYBOARD_NAME
    default "Dactyl-Manuform-L"

config ZMK_SPLIT_BLE_ROLE_CENTRAL
    default y

endif

if SHIELD_DACTYL_MANUFORM_RIGHT

config ZMK_KEYBOARD_NAME
    default "Dactyl-Manuform-R"

endif

if SHIELD_DACTYL_MANUFORM_LEFT || SHIELD_DACTYL_MANUFORM_RIGHT

config ZMK_SPLIT
    default y
endif
```
