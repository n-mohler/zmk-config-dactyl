#include "dactyl_manuform.dtsi"

&kscan0 {
    col-gpios
        = <&pro_micro 5 GPIO_ACTIVE_HIGH>
        , <&pro_micro 6 GPIO_ACTIVE_HIGH>
        , <&pro_micro 7 GPIO_ACTIVE_HIGH>
        , <&pro_micro 8 GPIO_ACTIVE_HIGH>
        , <&pro_micro 9 GPIO_ACTIVE_HIGH>
        ;
};


&pro_micro {
    gpio_wakeup_trigger_left: gpio_wakeup_trigger_left {
        compatible = "zmk,gpio-key-wakeup-trigger";
        wakeup-source;
        trigger = <&pro_micro 9 GPIO_ACTIVE_LOW>;
        extra-gpios = <&pro_micro 9 (GPIO_ACTIVE_LOW | GPIO_PULL_UP)>;
    };

    soft_off_wakeup_sources {
        compatible = "zmk,soft-off-wakeup-sources";
        wakeup-sources = <&gpio_wakeup_trigger_left>;
    };
};